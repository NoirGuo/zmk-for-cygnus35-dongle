## boards/shields/cygnus35/Kconfig.shield
```kconfig
# Copyright (c) 2025 Noir Guo
# SPDX-License-Identifier: MIT

config SHIELD_CYGNUS35_DONGLE
    def_bool $(shields_list_contains,cygnus35_dongle)

config SHIELD_CYGNUS35_PH_LEFT
    def_bool $(shields_list_contains,cygnus35_ph_left)

config SHIELD_CYGNUS35_RIGHT
    def_bool $(shields_list_contains,cygnus35_right)
```
